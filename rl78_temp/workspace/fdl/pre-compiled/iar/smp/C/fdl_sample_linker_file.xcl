//=================================================================================================
// Project      = Flash Data Access Library (T01)
// Module       = fdl_sample_linker_file.xcl
// Device:      = RL78
// Version      = E1.10
// Date         = 31.01.2011 15:22:14
//=================================================================================================
//                                  COPYRIGHT
//=================================================================================================
// Copyright (c) 2010 by Renesas Electronics Europe GmbH, a company of the Renesas Electronics) GmbH,
// Corporation. All rights reserved.
//=================================================================================================
// Purpose:
//              linker sample file
//
//=================================================================================================
//
// Warranty Disclaimer
//
// Because the Product(s) is licensed free of charge, there is no warranty of any kind whatsoever
// and expressly disclaimed and excluded by Renesas, either expressed or implied, including but
// not limited to those for non-infringement of intellectual property, merchantability and/or
// fitness for the particular purpose.
// Renesas shall not have any obligation to maintain, service or provide bug fixes for the
// supplied Product(s) and/or the Application.
//
// Each User is solely responsible for determining the appropriateness of using the Product(s)
// and assumes all risks associated with its exercise of rights under this Agreement, including,
// but not limited to the risks and costs of program errors, compliance with applicable laws,
// damage to or loss of data, programs or equipment, and unavailability or interruption of
// operations.
//
// Limitation of Liability
//
// In no event shall Renesas be liable to the User for any incidental, consequential, indirect,
// or punitive damage (including but not limited to lost profits) regardless of whether such
// liability is based on breach of contract, tort, strict liability, breach of warranties,
// failure of essential purpose or otherwise and even if advised of the possibility of such
// damages. Renesas shall not be liable for any services or products provided by third party
// vendors, developers or consultants identified or referred to the User by Renesas in
// connection with the Product(s) and/or the Application.
//
//=================================================================================================
//
// Environment  = IAR environment for RL78 (version V1.xx)
//
//=================================================================================================




//-------------------------------------------------------------------------
//      Define CPU
//-------------------------------------------------------------------------
-cRL78

//-------------------------------------------------------------------------
//      Size of the stack.
//      Remove comment and modify number if used from command line.
//-------------------------------------------------------------------------
//-D_CSTACK_SIZE=80

//-------------------------------------------------------------------------
//      Near constant location.
//      0 -> Mirrored in rom area 0x00000 - 0x0FFFF
//      1 -> Mirrored in rom area 0x10000 - 0x1FFFF
//      2 -> Writeable constants
//      Remove comments and modify number if used from command line.
//-------------------------------------------------------------------------
//-D_NEAR_CONST_LOCATION=0
//-D_NEAR_CONST_LOCATION_START=00800
//-D_NEAR_CONST_LOCATION_END=00FFF

//-------------------------------------------------------------------------
//      Size of the heaps.
//      Remove comment and modify number if used from command line.
//-------------------------------------------------------------------------
//-D_NEAR_HEAP_SIZE=400
//-D_FAR_HEAP_SIZE=4000

//-------------------------------------------------------------------------
//      Used by DLIB only
//      Define the format functions used by printf/scanf.
//      Default is full formatting.
//      Remove appropriate comment(s) to get reduced formatting
//      if used from command line.
//-------------------------------------------------------------------------
//-e_PrintfTiny=_Printf
//-e_PrintfSmall=_Printf
//-e_PrintfLarge=_Printf

//-e_ScanfSmall=_Scanf
//-e_ScanfLarge=_Scanf

//-------------------------------------------------------------------------
//      Used by DLIB only
//      Define if row buffering should be used by terminal output.
//      Default is no buffering.
//      Remove comment to get buffered terminal output if used from command line.
//-------------------------------------------------------------------------
//-e__write_buffered=__write

//-------------------------------------------------------------------------
//      Used by CLIB only
//      Define the format functions used by printf/scanf.
//      Default is full formatting.
//      Remove appropriate comment(s) to get reduced formatting
//      if used from command line.
//-------------------------------------------------------------------------
//-e_small_write=_formatted_write
//-e_medium_write=_formatted_write

//-e_medium_read=_formatted_read

//-------------------------------------------------------------------------
//      Allocate the read only segments that are mapped to ROM.
//-------------------------------------------------------------------------
//-------------------------------------------------------------------------
//      Interrupt vector segment.
//-------------------------------------------------------------------------
-Z(CODE)INTVEC=00000-0007F

//-------------------------------------------------------------------------
//      CALLT vector segment.
//-------------------------------------------------------------------------
-Z(CODE)CLTVEC=00080-000BF

//-------------------------------------------------------------------------
//      OPTION BYTES segment.
//-------------------------------------------------------------------------
-Z(CODE)OPTBYTE=000C0-000C3

//-------------------------------------------------------------------------
//      SECURITY_ID segment.
//-------------------------------------------------------------------------
-Z(CODE)SECUID=000C4-000CD

//-------------------------------------------------------------------------
//      Reserved ROM area for Minicube Firmware: 000D0-00383
//-------------------------------------------------------------------------


//-------------------------------------------------------------------------
//      FAR far data segments.
//      The FAR_I and FAR_ID segments must start at the same offset
//      in a 64 Kb page.
//-------------------------------------------------------------------------
-Z(FARCONST)FAR_ID=02FFF-FFFF
-Z(FARDATA)FAR_I=FF700-FFEDF


// FAL
// ============
-Z(CODE)FAL_CODE=[01000-01FFE]/10000
-Z(CONST)FAL_CNST=[01000-01FFE]/10000


//-------------------------------------------------------------------------
//      Startup, Runtime-library, Near, Interrupt
//      and CALLT functions code segment.
//-------------------------------------------------------------------------
-Z(CODE)RCODE,CODE=02000-FFFF

//-------------------------------------------------------------------------
//      Far functions code segment.
//-------------------------------------------------------------------------
-Z(CODE)XCODE=[02000-FFFF]/10000

//-------------------------------------------------------------------------
//      Data initializer segments.
//-------------------------------------------------------------------------
-Z(CONST)NEAR_ID=[02000-FFFF]/10000
-Z(CONST)SADDR_ID=[02000-FFFF]/10000
-Z(CONST)DIFUNCT=[02000-FFFF]/10000

//-------------------------------------------------------------------------
//      Constant segments
//-------------------------------------------------------------------------
-Z(CONST)NEAR_CONST=_NEAR_CONST_LOCATION_START-_NEAR_CONST_LOCATION_END
-P(CONST)FAR_CONST=[02000-FFFF]/10000
-Z(CONST)SWITCH=02000-FFFF
-Z(CONST)FSWITCH=[02000-FFFF]/10000

//-------------------------------------------------------------------------
//      Allocate the read/write segments that are mapped to RAM.
//-------------------------------------------------------------------------
//-------------------------------------------------------------------------
//      Short address data and workseg segments.
//-------------------------------------------------------------------------
-Z(DATA)WRKSEG=FFE20-FFEDF
-Z(DATA)SADDR_I,SADDR_Z,SADDR_N,FAL_DATA=FFE20-FFEDF

//-------------------------------------------------------------------------
//      Near data segments.
//-------------------------------------------------------------------------
-Z(DATA)NEAR_I,NEAR_Z,NEAR_N=FF700-FFEDF


//-------------------------------------------------------------------------
//      Far data segments.
//-------------------------------------------------------------------------
-Z(FARDATA)FAR_Z=FF700-FFEDF
-P(DATA)FAR_N=[FF700-FFEDF]/10000


//-------------------------------------------------------------------------
//      Heap segments.
//-------------------------------------------------------------------------
-Z(DATA)NEAR_HEAP+_NEAR_HEAP_SIZE=FF700-FFEDF
-Z(DATA)FAR_HEAP+_FAR_HEAP_SIZE=[FF700-FFEDF]/10000


//-------------------------------------------------------------------------
//      Stack segment.
//-------------------------------------------------------------------------
-Z(DATA)CSTACK+_CSTACK_SIZE=FF700-FFEDF


//-------------------------------------------------------------------------
//      Select the output file format if used from command line.
//      Remove comment to select the file format if used from command line.
//-------------------------------------------------------------------------
//-Fdebug


//-------------------------------------------------------------------------
//      End of File
//-------------------------------------------------------------------------